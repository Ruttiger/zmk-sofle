/* The central-left overlay supplies i2c0, P0.17/P0.20 pinctrl and &oled. */

&oled {
    compatible = "solomon,ssd1306fb";
    reg = <0x3c>;
    width = <128>;
    height = <64>;
    multiplex-ratio = <63>;
    segment-remap;
    com-invdir;
    inversion-on;
    prechargep = <0x22>;
};
