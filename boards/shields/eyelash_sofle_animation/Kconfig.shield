## boards/shields/eyelash_sofle_animation/Kconfig.shield
```kconfig
config SHIELD_EYELASH_SOFLE_ANIMATION
	def_bool $(shields_list_contains,eyelash_sofle_animation)
```

## boards/shields/eyelash_sofle_display_preview/Kconfig.shield
```kconfig
# Copyright (c) 2024 The ZMK Contributors
# SPDX-License-Identifier: MIT

config SHIELD_EYELASH_SOFLE_DISPLAY_PREVIEW
    def_bool $(shields_list_contains,eyelash_sofle_display_preview)
```
