## boards/shields/oled_raw_portrait_cal/Kconfig.shield
```kconfig
config SHIELD_OLED_RAW_PORTRAIT_CAL
    def_bool $(shields_list_contains,oled_raw_portrait_cal)

if SHIELD_OLED_RAW_PORTRAIT_CAL

config NICE_OLED_ON
    bool
    default n

endif # SHIELD_OLED_RAW_PORTRAIT_CAL
```

## boards/shields/oled_raw_ssd1306_128x32/Kconfig.shield
```kconfig
config SHIELD_OLED_RAW_SSD1306_128X32
    def_bool $(shields_list_contains,oled_raw_ssd1306_128x32)

if SHIELD_OLED_RAW_SSD1306_128X32

config NICE_OLED_ON
    bool
    default n

endif # SHIELD_OLED_RAW_SSD1306_128X32
```

## boards/shields/oled_raw_ssd1306_128x64/Kconfig.shield
```kconfig
config SHIELD_OLED_RAW_SSD1306_128X64
    def_bool $(shields_list_contains,oled_raw_ssd1306_128x64)

if SHIELD_OLED_RAW_SSD1306_128X64

config NICE_OLED_ON
    bool
    default n

endif # SHIELD_OLED_RAW_SSD1306_128X64
```

## boards/shields/oled_raw_ssd1306_128x64_edges_debug/Kconfig.shield
```kconfig
config SHIELD_OLED_RAW_SSD1306_128X64_EDGES_DEBUG
    def_bool $(shields_list_contains,oled_raw_ssd1306_128x64_edges_debug)

if SHIELD_OLED_RAW_SSD1306_128X64_EDGES_DEBUG

config NICE_OLED_ON
    bool "Enable nice OLED compatibility (must remain disabled for this test)"
    default n

endif # SHIELD_OLED_RAW_SSD1306_128X64_EDGES_DEBUG
```

## boards/shields/oled_resolution_diag/Kconfig.defconfig
```kconfig
if SHIELD_OLED_RESOLUTION_DIAG

config NICE_OLED_ON
    bool
    default n

config NICE_OLED_CUSTOM_CANVAS_WIDTH
    int "Compatibility canvas width (unused by the diagnostic)"
    default 64

config NICE_OLED_CUSTOM_CANVAS_HEIGHT
    int "Compatibility canvas height (unused by the diagnostic)"
    default 128

config ZMK_DISPLAY
    default y

config I2C
    default y

config SSD1306
    default y

endif # SHIELD_OLED_RESOLUTION_DIAG
```

## boards/shields/oled_resolution_diag/Kconfig.shield
```kconfig
config SHIELD_OLED_RESOLUTION_DIAG
    def_bool $(shields_list_contains,oled_resolution_diag)
```

## boards/shields/oled_resolution_diag_128x32/Kconfig.shield
```kconfig
config SHIELD_OLED_RESOLUTION_DIAG_128X32
    def_bool $(shields_list_contains,oled_resolution_diag_128x32)
```

## boards/shields/oled_resolution_diag_128x64/Kconfig.shield
```kconfig
config SHIELD_OLED_RESOLUTION_DIAG_128X64
    def_bool $(shields_list_contains,oled_resolution_diag_128x64)
```

## boards/shields/oled_ui_32x128_v1/Kconfig.shield
```kconfig
config SHIELD_OLED_UI_32X128_V1
    def_bool $(shields_list_contains,oled_ui_32x128_v1)
```

## boards/shields/oled_ui_32x128_v2_layer/Kconfig.shield
```kconfig
config SHIELD_OLED_UI_32X128_V2_LAYER
    def_bool $(shields_list_contains,oled_ui_32x128_v2_layer)
```

## boards/shields/oled_ui_v1/Kconfig.shield
```kconfig
config SHIELD_OLED_UI_V1
    def_bool $(shields_list_contains,oled_ui_v1)

if SHIELD_OLED_UI_V1

config NICE_OLED_ON
    bool
    default n

endif # SHIELD_OLED_UI_V1
```

## boards/shields/oled_ui_v2_layer/Kconfig.shield
```kconfig
config SHIELD_OLED_UI_V2_LAYER
    def_bool $(shields_list_contains,oled_ui_v2_layer)

if SHIELD_OLED_UI_V2_LAYER

config NICE_OLED_ON
    bool
    default n

endif # SHIELD_OLED_UI_V2_LAYER
```
